## config/boards/shields/virgo42/Kconfig.defconfig
```kconfig
# Copyright (c) 2020 The ZMK Contributors
# SPDX-License-Identifier: MIT

if SHIELD_virgo42

config ZMK_KEYBOARD_NAME
	default "virgo42"

endif
```

## config/boards/shields/virgo42/Kconfig.shield
```kconfig
# Copyright (c) 2020 The ZMK Contributors
# SPDX-License-Identifier: MIT

config SHIELD_virgo42
	def_bool $(shields_list_contains,virgo42)
```
